## linux-5.10.108/sound/soc/quard_star/Kconfig
```kconfig
# SPDX-License-Identifier: GPL-2.0-only
menu "Quard Star SOC audio support"

config SND_SOC_QUARD_STAR_I2S
	tristate "Quard Star I2S interface support"
	depends on OF || COMPILE_TEST
	depends on SND_SOC
	select SND_SOC_GENERIC_DMAENGINE_PCM
	select REGMAP_MMIO
	help
	  Say Y if you want to enable I2S for Quard Star SOC
endmenu
```

## opensbi-1.2/platform/quard_star/Kconfig
```kconfig
# SPDX-License-Identifier: BSD-2-Clause

config PLATFORM_NUCLEI_UX600
	bool
	select FDT
	select FDT_DOMAIN
	select FDT_PMU
	default y
```

## qemu-6.0.0/hw/riscv/Kconfig
```kconfig
config IBEX
    bool

config MICROCHIP_PFSOC
    bool
    select CADENCE_SDHCI
    select MCHP_PFSOC_DMC
    select MCHP_PFSOC_IOSCB
    select MCHP_PFSOC_MMUART
    select MCHP_PFSOC_SYSREG
    select MSI_NONBROKEN
    select SIFIVE_CLINT
    select SIFIVE_PDMA
    select SIFIVE_PLIC
    select UNIMP

config OPENTITAN
    bool
    select IBEX
    select UNIMP

config RISCV_VIRT
    bool
    imply PCI_DEVICES
    imply TEST_DEVICES
    select GOLDFISH_RTC
    select MSI_NONBROKEN
    select PCI
    select PCI_EXPRESS_GENERIC_BRIDGE
    select PFLASH_CFI01
    select SERIAL
    select SIFIVE_CLINT
    select SIFIVE_PLIC
    select SIFIVE_TEST
    select VIRTIO_MMIO
    select FW_CFG_DMA

config QUARD_STAR
    bool
    select QUARD_STAR_SYSCON
    select GOLDFISH_RTC
    select MSI_NONBROKEN
    select PFLASH_CFI01
    select SERIAL
    select SIFIVE_CLINT
    select SIFIVE_PLIC
    select SIFIVE_GPIO
    select SIFIVE_PDMA
    select VIRTIO_MMIO
    select FW_CFG_DMA
    select I2C
    select IMX_I2C
    select AT24C
    select SSI
    select SIFIVE_SPI
    select USB_DWC3
    select USB
    select CADENCE_SDHCI
    select MARVELL_88W8618
    select WM8750

config SIFIVE_E
    bool
    select MSI_NONBROKEN
    select SIFIVE_CLINT
    select SIFIVE_GPIO
    select SIFIVE_PLIC
    select SIFIVE_UART
    select SIFIVE_E_PRCI
    select UNIMP

config SIFIVE_U
    bool
    select CADENCE
    select MSI_NONBROKEN
    select SIFIVE_CLINT
    select SIFIVE_GPIO
    select SIFIVE_PDMA
    select SIFIVE_PLIC
    select SIFIVE_SPI
    select SIFIVE_UART
    select SIFIVE_U_OTP
    select SIFIVE_U_PRCI
    select SSI_M25P80
    select SSI_SD
    select UNIMP

config SPIKE
    bool
    select HTIF
    select MSI_NONBROKEN
    select SIFIVE_CLINT
    select SIFIVE_PLIC
```

## u-boot-2021.07/board/emulation/qemu-quard-star/Kconfig
```kconfig
if TARGET_QEMU_QUARD_STAR

config SYS_BOARD
	default "qemu-quard-star"

config SYS_VENDOR
	default "emulation"

config SYS_CPU
	default "generic"

config SYS_CONFIG_NAME
	default "qemu-quard-star"

config SYS_TEXT_BASE
	default 0xB0200000

config BOARD_SPECIFIC_OPTIONS # dummy
	def_bool y
	select GENERIC_RISCV
	imply AHCI
	imply SMP
	imply BOARD_LATE_INIT
	imply CMD_POWEROFF
	imply CMD_EXT2
	imply CMD_EXT4
	imply CMD_FAT
	imply CMD_FS_GENERIC
	imply DOS_PARTITION
	imply ISO_PARTITION
	imply EFI_PARTITION
	imply SYS_NS16550
	imply SIFIVE_SERIAL
	imply SYSRESET
	imply SYSRESET_CMD_POWEROFF
	imply SYSRESET_SYSCON

endif
```

## u-boot-2021.07/configs/qemu-quard-star_defconfig
```kconfig
CONFIG_RISCV=y
CONFIG_NR_DRAM_BANKS=1
CONFIG_ENV_SIZE=0x20000
CONFIG_TARGET_QEMU_QUARD_STAR=y
CONFIG_ARCH_RV64I=y
CONFIG_RISCV_SMODE=y
CONFIG_DISTRO_DEFAULTS=y
CONFIG_FIT=y
CONFIG_DISPLAY_CPUINFO=y
CONFIG_DISPLAY_BOARDINFO=y
CONFIG_CMD_BOOTEFI_SELFTEST=y
CONFIG_CMD_NVEDIT_EFI=y
CONFIG_CMD_MEMTEST=y
CONFIG_CMD_MTD=y
CONFIG_CMD_MTDPARTS=y
CONFIG_CMD_NET=y
CONFIG_CMD_LINK_LOCAL=y
CONFIG_CMD_DNS=y
CONFIG_CMD_AES=y
CONFIG_CMD_HASH=y
CONFIG_CMD_MD5SUM=y
CONFIG_CMD_EXCEPTION=y
CONFIG_CMD_SBI=y
CONFIG_CMD_LICENSE=y
CONFIG_OF_PRIOR_STAGE=y
CONFIG_SYS_RELOC_GD_ENV_ADDR=y
CONFIG_BLK=y
CONFIG_MTD=y
CONFIG_DM_MTD=y
CONFIG_MTD_NOR_FLASH=y
CONFIG_FLASH_CFI_DRIVER=y
CONFIG_CFI_FLASH=y
CONFIG_SYS_FLASH_USE_BUFFER_WRITE=y
CONFIG_FLASH_CFI_MTD=y
CONFIG_SYS_FLASH_CFI=y
CONFIG_DM_ETH=y
```

## u-boot-2023.04/configs/qemu-quard-star_defconfig
```kconfig
CONFIG_RISCV=y
CONFIG_NR_DRAM_BANKS=1
CONFIG_SYS_LOAD_ADDR=0x80000000
CONFIG_STANDALONE_LOAD_ADDR=0x80000000
CONFIG_HAS_CUSTOM_SYS_INIT_SP_ADDR=y
CONFIG_CUSTOM_SYS_INIT_SP_ADDR=0xB0080000
CONFIG_SYS_FLASH_BASE=0x20000000
CONFIG_ENV_SIZE=0x20000
CONFIG_SYS_MALLOC_F_LEN=0x10000
CONFIG_TARGET_QEMU_QUARD_STAR=y
CONFIG_ARCH_RV64I=y
CONFIG_RISCV_SMODE=y
CONFIG_DISTRO_DEFAULTS=y
CONFIG_FIT=y
CONFIG_DISPLAY_CPUINFO=y
CONFIG_DISPLAY_BOARDINFO=y
CONFIG_BOOTSTD=y
CONFIG_BOOTSTD_FULL=y
CONFIG_CMD_BOOTEFI_SELFTEST=y
CONFIG_CMD_NVEDIT_EFI=y
CONFIG_CMD_MEMTEST=y
CONFIG_CMD_MTD=y
CONFIG_CMD_MTDPARTS=y
CONFIG_CMD_NET=y
CONFIG_CMD_LINK_LOCAL=y
CONFIG_CMD_DNS=y
CONFIG_CMD_AES=y
CONFIG_CMD_HASH=y
CONFIG_CMD_MD5SUM=y
CONFIG_CMD_EXCEPTION=y
CONFIG_CMD_SBI=y
CONFIG_CMD_LICENSE=y
CONFIG_CMD_GPIO=y
CONFIG_CMD_PWM=y
CONFIG_CMD_TIMER=y
CONFIG_CMD_MMC=y
CONFIG_CMD_USB=y
CONFIG_CMD_USB_MASS_STORAGE=y
CONFIG_CMD_SPI=y
CONFIG_CMD_ONENAND=y
CONFIG_CMD_TFTPPUT=y
CONFIG_CMD_TFTPSRV=y
CONFIG_CMD_CAT=y
CONFIG_CMD_UUID=y
CONFIG_CMD_LSBLK=y
CONFIG_OF_PRIOR_STAGE=y
CONFIG_SYS_RELOC_GD_ENV_ADDR=y
CONFIG_BLK=y
CONFIG_MTD=y
CONFIG_DM_MTD=y
CONFIG_MTD_NOR_FLASH=y
# CONFIG_MTD_RAW_NAND is not set
CONFIG_FLASH_CFI_DRIVER=y
CONFIG_CFI_FLASH=y
CONFIG_SYS_FLASH_USE_BUFFER_WRITE=y
CONFIG_FLASH_CFI_MTD=y
CONFIG_SYS_FLASH_CFI=y
CONFIG_DM_ETH=y
CONFIG_USB=y
CONFIG_DM_USB=y
CONFIG_USB_XHCI_HCD=y
CONFIG_USB_XHCI_DWC3=y
CONFIG_USB_DWC3=y
# CONFIG_USB_DWC3_GADGET is not set
CONFIG_DM_GPIO=y
CONFIG_SIFIVE_GPIO=y
CONFIG_DM_PWM=y
CONFIG_PWM_SIFIVE=y
CONFIG_CMD_BMP=y
CONFIG_BMP_16BPP=y
CONFIG_VIDEO=y
CONFIG_VIDEO_LOGO=y
CONFIG_VIDEO_PL111=y
CONFIG_MMC=y
CONFIG_DM_MMC=y
CONFIG_MMC_WRITE=y
CONFIG_SUPPORT_EMMC_BOOT=y
CONFIG_MMC_SDHCI=y
CONFIG_MMC_SDHCI_CADENCE=y
CONFIG_DM_SPI=y
CONFIG_DM_SPI_FLASH=y
CONFIG_SPI=y
CONFIG_SPI_SIFIVE=y
CONFIG_SPI_FLASH_MTD=y
CONFIG_SPI_FLASH_ISSI=y
CONFIG_QSPI_BOOT=y
CONFIG_SD_BOOT=y
CONFIG_SPI_BOOT=y
CONFIG_ONENAND_BOOT=y
```
